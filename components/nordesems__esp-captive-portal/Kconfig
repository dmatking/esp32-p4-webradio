## components/nordesems__esp-captive-portal/Kconfig
```kconfig
menu "Captive Portal"

    config CAPTIVE_PORTAL_ENABLE_DHCP_OPTION_114
        bool "Enable DHCP Option 114 captive portal URI"
        default y
        help
            Enables advertising the captive portal URI through DHCP option 114
            (RFC 8910) on the soft-AP DHCP server.

            The URI value is derived from the same effective redirect target used
            by HTTP redirects:
              1) captive_portal_config_t.redirect_url (if set), otherwise
              2) dynamic IP from CAPTIVE_PORTAL_NETIF_KEY with redirect port,
                 with CAPTIVE_PORTAL_FALLBACK_IP as fallback.

            The component applies this option before registering HTTP URI
            handlers so DHCP-aware clients can discover the portal as early as
            possible.

    config CAPTIVE_PORTAL_NETIF_KEY
        string "Network interface key for IP auto-detection"
        default "WIFI_AP_DEF"
        help
            The esp_netif interface key used to look up the network interface
            when resolving the redirect IP address at request time.

            Common values:
              WIFI_AP_DEF   - Wi-Fi soft-AP (default, typical for captive portal)
              WIFI_STA_DEF  - Wi-Fi station
              ETH_DEF       - Ethernet

            This value is only used when captive_portal_config_t.redirect_url
            is NULL (dynamic IP detection mode).

    config CAPTIVE_PORTAL_FALLBACK_IP
        string "Fallback redirect IP address"
        default "192.168.4.1"
        help
            The IP address used in the redirect URL when the network interface
            IP cannot be determined (e.g. netif not found or not yet assigned).

            Must match the AP IP address configured by your Wi-Fi initialisation
            code. The ESP-IDF default soft-AP address is 192.168.4.1.

    config CAPTIVE_PORTAL_REDIRECT_PORT
        int "Redirect target TCP port"
        default 80
        range 1 65535
        help
            The TCP port of the target web server included in the generated
            redirect URL.

            Port 80 is treated as the standard HTTP port and is omitted from
            the URL (e.g. "http://192.168.4.1/" rather than
            "http://192.168.4.1:80/").

endmenu
```

## sdkconfig.defaults
```kconfig
# Target: ESP32-P4
CONFIG_IDF_TARGET="esp32p4"

# Flash
CONFIG_ESPTOOLPY_FLASHSIZE_16MB=y

# CPU (360 MHz)
CONFIG_ESP_DEFAULT_CPU_FREQ_360=y
CONFIG_FREERTOS_HZ=1000

# Console
CONFIG_ESP_CONSOLE_USB_SERIAL_JTAG=y

# Main task stack (needs to be large enough for display init)
CONFIG_ESP_MAIN_TASK_STACK_SIZE=16384

# Custom partition table (4 MB app partition)
CONFIG_PARTITION_TABLE_CUSTOM=y
CONFIG_PARTITION_TABLE_CUSTOM_FILENAME="partitions.csv"

# PSRAM (HEX @ 200 MHz — requires IDF_EXPERIMENTAL_FEATURES)
CONFIG_IDF_EXPERIMENTAL_FEATURES=y
CONFIG_SPIRAM=y
CONFIG_SPIRAM_MODE_HEX=y
CONFIG_SPIRAM_SPEED_200M=y

# esp_hosted: ESP32-C6 co-processor via SDIO for WiFi
CONFIG_ESP_HOSTED_ENABLED=y
CONFIG_ESP_HOSTED_SDIO_HOST_INTERFACE=y
CONFIG_ESP_HOSTED_IDF_SLAVE_TARGET="esp32c6"
CONFIG_ESP_HOSTED_SDIO_RESET_ACTIVE_HIGH=y
CONFIG_ESP_HOSTED_SDIO_GPIO_RESET_SLAVE=54
CONFIG_ESP_HOSTED_GPIO_SLAVE_RESET_SLAVE=54
CONFIG_ESP_HOSTED_SDIO_4_BIT_BUS=y
CONFIG_ESP_HOSTED_SDIO_BUS_WIDTH=4
CONFIG_ESP_HOSTED_SDIO_CLOCK_FREQ_KHZ=40000
CONFIG_ESP_HOSTED_SDIO_PIN_CMD=19
CONFIG_ESP_HOSTED_SDIO_PIN_CLK=18
CONFIG_ESP_HOSTED_SDIO_PIN_D0=14
CONFIG_ESP_HOSTED_SDIO_PIN_D1=15
CONFIG_ESP_HOSTED_SDIO_PIN_D2=16
CONFIG_ESP_HOSTED_SDIO_PIN_D3=17
CONFIG_ESP_WIFI_REMOTE_ENABLED=y

# Disable SoftAP (saves flash)
CONFIG_ESP_WIFI_SOFTAP_SUPPORT=n

# HTTPS for Radio Browser API
CONFIG_MBEDTLS_CERTIFICATE_BUNDLE=y
CONFIG_MBEDTLS_CERTIFICATE_BUNDLE_DEFAULT_FULL=y
```
